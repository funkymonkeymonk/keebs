## boards/shields/corne/Kconfig.defconfig
```kconfig
if SHIELD_CORNE_DONGLE

config ZMK_KEYBOARD_NAME
    default "Corne Dongle"

config ZMK_SPLIT_ROLE_CENTRAL
    default y

config ZMK_SPLIT
    default y

# Corne has 2 peripherals (left and right halves)
config ZMK_SPLIT_BLE_CENTRAL_PERIPHERALS
    default 2

# BT_MAX_CONN = peripherals (2) + BT profiles (5) = 7
config BT_MAX_CONN
    default 7

config BT_MAX_PAIRED
    default 7

endif

if SHIELD_CORNE_DONGLE_LEFT

config ZMK_KEYBOARD_NAME
    default "Corne Dongle Left"

config ZMK_SPLIT_ROLE_CENTRAL
    default y

config ZMK_SPLIT
    default y

config ZMK_SPLIT_BLE_CENTRAL_PERIPHERALS
    default 1

config BT_MAX_CONN
    default 6

config BT_MAX_PAIRED
    default 6

endif

if SHIELD_CORNE_DONGLE_RIGHT

config ZMK_KEYBOARD_NAME
    default "Corne Dongle Right"

config ZMK_SPLIT
    default y

endif
```

## boards/shields/corne/Kconfig.shield
```kconfig
# Corne Dongle Shield Configuration

config SHIELD_CORNE_DONGLE
    def_bool $(shields_list_contains,corne_dongle)

config SHIELD_CORNE_DONGLE_LEFT
    def_bool $(shields_list_contains,corne_dongle_left)

config SHIELD_CORNE_DONGLE_RIGHT
    def_bool $(shields_list_contains,corne_dongle_right)
```
